## kernel-space/tcptfs/Kconfig
```kconfig
config TCPT_FS
	tristate "tcptfs stackable file system (EXPERIMENTAL)"
	depends on EXPERIMENTAL
	help
	  tcptfs is a stackable file system which is part of TCPT
	transparent encrypting and decrypting system. It filters 
	the date passed by to with encryption and decryption. Use
	this file system with user-space tools.
```
